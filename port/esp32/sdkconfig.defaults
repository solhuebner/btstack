## port/esp32/sdkconfig.defaults
```kconfig
#
# Bluetooth
#
CONFIG_BT_ENABLED=y
CONFIG_BT_BLUEDROID_ENABLED=n
CONFIG_BT_CONTROLLER_ONLY=y

#
# Bluetooth Dual Mode
#
CONFIG_BTDM_CTRL_MODE_BTDM=y
CONFIG_BTDM_CTRL_MODE_BR_EDR_ONLY=n
CONFIG_BTDM_CTRL_BR_EDR_SCO_DATA_PATH_HCI=y
```
